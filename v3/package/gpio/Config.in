## v4/module-package/Config.in
```kconfig
config BR2_PACKAGE_SYSO
        bool "syso"
        help
          All Syso Packages



if BR2_PACKAGE_SYSO
        menu "Modules"
                source package/syso/template/Config.in
                source package/syso/openclose/Config.in
                source package/syso/templateold/Config.in
                source package/syso/zero/Config.in
                source package/syso/null/Config.in
		source package/syso/access/Config.in
        endmenu
endif
```

## v5/module-package/Config.in
```kconfig
config BR2_PACKAGE_SYSO
        bool "syso"
        help
          All Syso Packages



if BR2_PACKAGE_SYSO
        menu "Modules"
                source package/syso/kernelThread/Config.in
                source package/syso/mutex/Config.in
                source package/syso/sema/Config.in
                source package/syso/tasklet/Config.in
                source package/syso/null/Config.in
		source package/syso/timer/Config.in
		source package/syso/workQueue/Config.in
		source package/syso/access/Config.in
		source package/syso/buffer/Config.in
        endmenu
endif
```

## v5/module-package/kernelThread/Config.in
```kconfig
config BR2_PACKAGE_KERNELTHREAD
		bool "kernelThread"
		help
		  Kernel Thread Driver
```

## v5/module-package/sema/Config.in
```kconfig
config BR2_PACKAGE_SEMA
		bool "semaphore and Spinlock"
		help
		  Semaphore and Spinlock Driver
```

## v6/module-package/Config.in
```kconfig
config BR2_PACKAGE_SYSO
        bool "syso"
        help
          All Syso Packages



if BR2_PACKAGE_SYSO
        menu "Modules"
                source package/syso/mygpio/Config.in
                source package/syso/ledmax/Config.in
                source package/syso/led250/Config.in
                source package/syso/ledflip/Config.in
                source package/syso/ledmaxSys/Config.in
        endmenu
endif
```

## v6/module-package/led250/Config.in
```kconfig
config BR2_PACKAGE_LED250
	bool "led250 test"
	help
	  Tests led with 250HZ for mygpio
```

## v6/module-package/ledflip/Config.in
```kconfig
config BR2_PACKAGE_LEDFLIP
	bool "ledflip test"
	help
	  Tests ledflip for mygpio
```

## v6/module-package/ledmaxSys/Config.in
```kconfig
config BR2_PACKAGE_LEDMAXSYS
	bool "ledmaxSys"
	help
	  Tests max frequenz for mygpio with sys
```
